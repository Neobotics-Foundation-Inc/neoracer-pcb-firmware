## firmware/source/main/Kconfig.projbuild
```kconfig
menu "OSCore USB"

choice OSCORE_USB_BACKEND
    prompt "USB serial backend"
    default OSCORE_USB_BACKEND_TINYUSB
    help
        Select the USB serial implementation used by the firmware protocol.
        USB Serial/JTAG keeps the current ESP32-S3 built-in debug CDC path.
        TinyUSB CDC allows product USB descriptor customization.

    config OSCORE_USB_BACKEND_SERIAL_JTAG
        bool "ESP32-S3 USB Serial/JTAG"

    config OSCORE_USB_BACKEND_TINYUSB
        bool "TinyUSB CDC"
endchoice

config OSCORE_USB_PRODUCT_STRING
    string "TinyUSB product string"
    default "Neoracer V1"
    depends on OSCORE_USB_BACKEND_TINYUSB

config OSCORE_USB_MANUFACTURER_STRING
    string "TinyUSB manufacturer string"
    default "Seeed Studio & OSRBOT"
    depends on OSCORE_USB_BACKEND_TINYUSB

config OSCORE_USB_SERIAL_STRING
    string "TinyUSB serial string"
    default "OSRCOREV01"
    depends on OSCORE_USB_BACKEND_TINYUSB

endmenu

menu "OSCore chassis"

config OSCORE_ENCODER_A_GPIO
    int "Encoder A GPIO"
    default 3
    range 0 48

config OSCORE_ENCODER_B_GPIO
    int "Encoder B GPIO"
    default 9
    range 0 48

config OSCORE_ENCODER_PPR
    int "Encoder pulses per motor revolution"
    default 1024
    range 1 100000

config OSCORE_GEAR_RATIO_MILLI
    int "Total gear ratio x1000"
    default 10550
    range 1 1000000
    help
        Total motor-to-wheel gear ratio multiplied by 1000.
        Example: 10.55 should be configured as 10550.

config OSCORE_WHEEL_RADIUS_UM
    int "Wheel radius in micrometers"
    default 42500
    range 1 1000000
    help
        Wheel radius in micrometers. Example: 85 mm diameter uses 42500.

config OSCORE_SPEED_CALC_INTERVAL_MS
    int "Encoder speed calculation interval in ms"
    default 20
    range 1 1000

endmenu
```

## firmware/source/sdkconfig.defaults
```kconfig
# ESP32-S3-WROOM-1U-N16R8
CONFIG_IDF_TARGET="esp32s3"

# Verified flashing profile: 16MB image header, DIO, 80MHz
# Physical module: 16MB Flash + 8MB Octal PSRAM
CONFIG_ESPTOOLPY_FLASHSIZE_16MB=y
CONFIG_ESPTOOLPY_FLASHMODE_DIO=y
CONFIG_ESPTOOLPY_FLASHFREQ_80M=y

# OTA app layout for serial firmware updates
CONFIG_PARTITION_TABLE_CUSTOM=y
CONFIG_PARTITION_TABLE_CUSTOM_FILENAME="partitions_ota.csv"
CONFIG_BOOTLOADER_APP_ROLLBACK_ENABLE=y

# PSRAM: 8MB Octal
CONFIG_SPIRAM=y
CONFIG_SPIRAM_MODE_OCT=y
CONFIG_SPIRAM_SPEED_80M=y

# USB CDC protocol port (UART0 is used for SBUS)
CONFIG_OSCORE_USB_BACKEND_TINYUSB=y
CONFIG_OSCORE_USB_PRODUCT_STRING="Neoracer V1"
CONFIG_OSCORE_USB_MANUFACTURER_STRING="Seeed Studio & OSRBOT"
CONFIG_OSCORE_USB_SERIAL_STRING="OSRCOREV01"
CONFIG_TINYUSB_CDC_ENABLED=y
CONFIG_TINYUSB_CDC_COUNT=1
CONFIG_TINYUSB_CDC_RX_BUFSIZE=512
CONFIG_TINYUSB_CDC_TX_BUFSIZE=512
CONFIG_TINYUSB_CDC_EP_BUFSIZE=512
CONFIG_ESPTOOLPY_MONITOR_BAUD=460800

# NVS
CONFIG_NVS_ENCRYPTION=n

# FreeRTOS tick rate
CONFIG_FREERTOS_HZ=1000

# Chassis physical parameters
CONFIG_OSCORE_ENCODER_A_GPIO=3
CONFIG_OSCORE_ENCODER_B_GPIO=9
CONFIG_OSCORE_ENCODER_PPR=1024
CONFIG_OSCORE_GEAR_RATIO_MILLI=10550
CONFIG_OSCORE_WHEEL_RADIUS_UM=42500
CONFIG_OSCORE_SPEED_CALC_INTERVAL_MS=20

# Compiler: C++17
CONFIG_COMPILER_CXX_EXCEPTIONS=n
CONFIG_COMPILER_STACK_CHECK_MODE_NONE=y
```
